## app/drivers/zephyr/dts/bindings/lcds/ht,hd44780.yaml
```yaml
description: 1602 LCD HD 44780

compatible: "hit,hd44780"

include: i2c-device.yaml
```

## app/dts/bindings/behaviors/zmk,behavior-rpn-calculator.yaml
```yaml
# Copyright (c) 2020 The ZMK Contributors
# SPDX-License-Identifier: MIT

description: Adds support for an RPN style calculator input.

compatible: "zmk,behavior-rpn-calculator"

include: one_param.yaml
```
